/ {
    // Set up the keyboard scanning matrix
    &kscan0 {
        row-gpios = <&gpio0 17>, <&gpio0 20>, <&gpio0 22>, <&gpio0 24>;   
        col-gpios = <&gpio1 10>, <&gpio0 11>, <&gpio0 31>, <&gpio0 29>, <&gpio0 2>, <&gpio1 15>;  
        diode-direction = <COL2ROW>;
    }

    // Rotary encoder
    encoder0: encoder0 {
        compatible = "zmk,behavior-rotary-encoder";
        a-pin = <&gpio1 13>;
        b-pin = <&gpio1 11>;
        steps = <4>;
        label = "Volume Encoder";
    };
};
